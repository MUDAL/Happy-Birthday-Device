/*
 * Simple birthday gift for my sister 
 * Credits:
 * 1. Vector X (https://www.youtube.com/watch?v=d-WkHkuYSPQ)
 * 2. Adafruit OLED Library (The Adafruit_SH1106.cpp was modified to suit the Arduino Nano)
 * (Modification:: Wire.begin(sda,scl) to Wire.begin())
 * 3. http://cliparts.co/cliparts/pi7/Ky4/pi7Ky4xrT.png
 * 4. https://marlinfw.org/tools/u8glib/converter.html
 * 
*/
#include <avr/io.h>
#include <avr/interrupt.h>
#include <Adafruit_GFX.h>
#include <Adafruit_SH1106.h>
#include "pitches.h"

#define BLUE_LED      9
#define RED_LED      10
#define BUZZER       11

#define NUM_OF_NOTES 28
#define TEMPO        65 //speed up or slow down the song

//Bitmap for 'LOVE' icon
/**
 * Made with Marlin Bitmap Converter
 * https://marlinfw.org/tools/u8glib/converter.html
 *
 * This bitmap from the file 'LOVE4 (2).png'
 */
#pragma once
#define BMPWIDTH  69

const unsigned char bitmap_love[] PROGMEM = {
  B00000000,B00000001,B11111110,B00000000,B00000000,B00000011,B11111110,B00000000,B00000000,
  B00000000,B00011111,B11111111,B11000000,B00000000,B00011111,B11111111,B11000000,B00000000,
  B00000000,B01111111,B11111111,B11110000,B00000000,B01111111,B11111111,B11110000,B00000000,
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  B00000000,B00000000,B00000000,B00000000,B01110000,B00000000,B00000000,B00000000,B00000000
};

volatile int NOTE_SEQ[NUM_OF_NOTES] = 
{
  NOTE_C5, NOTE_C5, NOTE_D5, NOTE_C5, NOTE_F5, NOTE_E5, PAUSE,
  NOTE_C5, NOTE_C5, NOTE_D5, NOTE_C5, NOTE_G5, NOTE_F5, PAUSE,
  NOTE_C5, NOTE_C5, NOTE_C6, NOTE_A5, NOTE_F5, NOTE_E5, NOTE_D5, PAUSE,
  NOTE_AS5, NOTE_AS5, NOTE_A5, NOTE_F5, NOTE_G5, NOTE_F5 
};
//Length of notes
volatile int NOTE_LEN[NUM_OF_NOTES] = 
{
  4,2,8,8,8,16,50,     //50  millis for the first pause
  4,2,8,8,8,16,100,    //100 millis for the second pause
  4,2,8,8,8,8,16,150,    //150 millis for the third pause
  4,2,8,8,8,20 
};
// Declaration for an SH1106 display connected to I2C (SDA, SCL pins)
Adafruit_SH1106 oled(A4,A5);

//Functions
void ToggleLEDs(void)
{
  static bool state;
  state ^= 1;
  if(state)
  {
    digitalWrite(BLUE_LED,HIGH);
    digitalWrite(RED_LED,LOW);
  }
  else
  {
    digitalWrite(BLUE_LED,LOW);
    digitalWrite(RED_LED,HIGH);
  }
}

void TimerInit(void)
{
  TCCR1B = (1<<WGM12)|(1<<CS11)|(1<<CS10); //CTC mode, prescalar = 64
  OCR1A = 249; //1ms repetition rate 
  sei();//enable global interrupt
  TIMSK1 = (1<<OCIE1A); //enable timer 1 compare match A interrupt  
}

void Display(char* msg,int row = 1, int col = 1)
{
  oled.clearDisplay();
  oled.setCursor(row,col);
  oled.print(msg);
  oled.display();
}

void DisplayLove(void)
{
  oled.clearDisplay();
  oled.drawBitmap(30,0,bitmap_love,BMPWIDTH,64,WHITE);
  oled.display();
}

void setup(void) 
{
  pinMode(BLUE_LED,OUTPUT);
  pinMode(RED_LED,OUTPUT);
  TimerInit();
  oled.begin(SH1106_SWITCHCAPVCC,0x3C);
  oled.setTextSize(1);
  oled.setTextColor(WHITE);
}

void loop(void) 
{
  Display("HAPPY BIRTHDAY\n\nTO YOU");
  delay(3000);
  Display("WE WISH YOU A LONG\n\nLIFE AND PROSPERITY");
  delay(3000);
  DisplayLove();
  delay(3000);
}

ISR(TIMER1_COMPA_vect)
{
  static int count;
  static int ledCount;
  static int i;
  static bool toneOn;
  int period = NOTE_LEN[i % NUM_OF_NOTES] * TEMPO;

  if((ledCount % 500) == 0)
  {
    //Toggle LEDs every 500ms
    ToggleLEDs();
  }
  ledCount++; 
  
  if(NOTE_SEQ[i % NUM_OF_NOTES] != PAUSE)
  {
    if(count < period / 2)
    {
      if(!toneOn)
      {
        tone(BUZZER,NOTE_SEQ[i % NUM_OF_NOTES]); 
        toneOn = true;
      }
    }
    else
    {
      noTone(BUZZER);
      if(count >= period)
      {
        toneOn = false;
        count = 0;
        i++;
      }
    }
    count++;
  }
  else
  {
    i++;
  } 
}
